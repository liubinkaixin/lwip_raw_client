/*-------------------------------------------------*/
/*          助开发网STM32F407ZGT6开发板            */
/*    淘宝地址： https://shop68304486.taobao.com   */
/*-------------------------------------------------*/
/*-------------------------------------------------*/
/*                                                 */
/*     中断处理源文件模板文件(ST提供,略做修改)     */
/*                                                 */
/*-------------------------------------------------*/
/*-------------------------------------------------*/

#include "stm32f4xx_it.h"
#include "usart1.h"
#include "8720.h"
#include "main.h"

/*-------------------------------------------------*/
/*函数名：不可屏蔽中断处理函数                     */
/*参  数：无                                       */
/*返回值：无                                       */
/*-------------------------------------------------*/
void NMI_Handler(void)
{

}

/*-------------------------------------------------*/
/*函数名：硬件出错后进入的中断处理函数             */
/*参  数：无                                       */
/*返回值：无                                       */
/*-------------------------------------------------*/
void HardFault_Handler(void)
{
	fault_led_show();
	if(CoreDebug->DHCSR & 1)
	{
		__breakpoint(0);
	}
	
	while(1);
	printf("发生HardFault错误，准备重启\r\n");
	NVIC_SystemReset();
}

/*-------------------------------------------------*/
/*函数名：内存管理中断处理函数                     */
/*参  数：无                                       */
/*返回值：无                                       */
/*-------------------------------------------------*/
void MemManage_Handler(void)
{

}

/*-------------------------------------------------*/
/*函数名：预取指失败，存储器访问失败中断处理函数   */
/*参  数：无                                       */
/*返回值：无                                       */
/*-------------------------------------------------*/
void BusFault_Handler(void)
{

}

/*-------------------------------------------------*/
/*函数名：未定义的指令或非法状态处理函数           */
/*参  数：无                                       */
/*返回值：无                                       */
/*-------------------------------------------------*/
void UsageFault_Handler(void)
{

}

/*-------------------------------------------------*/
/*函数名：软中断，SWI 指令调用的处理函数           */
/*参  数：无                                       */
/*返回值：无                                       */
/*-------------------------------------------------*/
void SVC_Handler(void)
{
	
}

/*-------------------------------------------------*/
/*函数名：调试监控器处理函数                       */
/*参  数：无                                       */
/*返回值：无                                       */
/*-------------------------------------------------*/
void DebugMon_Handler(void)
{
	
}

/*-------------------------------------------------*/
/*函数名：可挂起的系统服务处理函数                 */
/*参  数：无                                       */
/*返回值：无                                       */
/*-------------------------------------------------*/
void PendSV_Handler(void)
{
}

/*-------------------------------------------------*/
/*函数名：SysTic系统嘀嗒定时器处理函数             */
/*参  数：无                                       */
/*返回值：无                                       */
/*-------------------------------------------------*/
void SysTick_Handler(void)
{
	
}
/*-------------------------------------------------*/
/*函数名：定时器3中断服务函数                      */
/*参  数：无                                       */
/*返回值：无                                       */
/*-------------------------------------------------*/
void TIM3_IRQHandler(void)
{
	if(TIM_GetITStatus(TIM3,TIM_IT_Update)==SET) //溢出中断
	{
		LWipTime+=10;
	}
	TIM_ClearITPendingBit(TIM3,TIM_IT_Update);  //清除中断标志位
}

/*-------------------------------------------------*/
/*函数名：以太网中断处理函数                       */
/*参  数：无                                       */
/*返回值：无                                       */
/*-------------------------------------------------*/

extern ETH_DMADESCTypeDef  *DMARxDescToGet;  //当前DMA接收描述符指针，在以太网库文件中定义的

void ETH_IRQHandler(void)
{
  //检测是否收到数据包
  while(ETH_GetRxPktSize(DMARxDescToGet) != 0) 
  {		
    LwIP_Pkt_Handle();//接收数据函数
  }

  ETH_DMAClearITPendingBit(ETH_DMA_IT_R);     //清除DMA中断标志位
  ETH_DMAClearITPendingBit(ETH_DMA_IT_NIS);   //清除DMA接收中断标志位
}
/*-------------------------------------------------*/
/*函数名：串口1中断服务函数                        */
/*参  数：无                                       */
/*返回值：无                                       */
/*-------------------------------------------------*/
void USART1_IRQHandler(void)   //串口1中断服务程序，数据以\r\n作为结束标志
{
	u8 Res;

	if(USART_GetITStatus(USART1, USART_IT_RXNE) != RESET)  //进入接收中断
	{
		Res =USART_ReceiveData(USART1); //读取接收到的数据		
		if((USART1_RX_STA&0x8000)==0)    //==0，接收没完成：位15代表置位与否，代表接收是否完成
		{			
			if(USART1_RX_STA&0x4000)     //位14置位代表，接收到了\r
			{
				if(Res=='\n')           //如果接收到\n，如此一来\r\n都收到了，表示结束
				{				
					USART1_RX_BUF[USART1_RX_STA&0X3FFF]=Res; //记录下\n数据
					USART1_RX_STA++;	                     //角标+1
					USART1_RX_STA|=1<<15;	                 //位15置位，接收完成了 
				}
				else 
				{
					USART1_RX_BUF[USART1_RX_STA&0X3FFF]=Res; //记录下数据
					USART1_RX_STA++;	                        //角标+1
					USART1_RX_STA&=~(1<<14);                    //清除位14，接收到的\r不是代表结束，是正常数据	
				}
			}
			else
			{
				if(Res=='\r') //如果接收到了\r
				{
					USART1_RX_STA|=(1<<14);                  //位14置位代表，接收到了\r 
					USART1_RX_BUF[USART1_RX_STA&0X3FFF]=Res; //记录下\r
					USART1_RX_STA++;	                     //数组角标+1
				}
				else         //如果不是\r
				{
					USART1_RX_BUF[USART1_RX_STA&0X3FFF]=Res; //记录下数据
					USART1_RX_STA++;	                     //数组角标+1
				}				
			}
		}   		 
  } 
} 
